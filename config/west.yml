## config/west.yml
```yaml
manifest:
    remotes:
      - name: zmkfirmware
        url-base: https://github.com/zmkfirmware
      - name: AYM1607
        url-base: https://github.com/AYM1607
      - name: superxc3
        url-base: https://github.com/superxc3
    projects:
      - name: zmk
        remote: zmkfirmware
        revision: v0.3.0
        import: app/west.yml
      - name: zmk-driver-azoteq-iqs5xx
        remote: superxc3
        revision: main
    self:
      path: config
```
